## RT-Thread-v5.2.2/bsp/stm32/cooling-ctrl-board/Kconfig
```kconfig
mainmenu "RT-Thread Configuration"

BSP_DIR := .

RTT_DIR := ../../..

PKGS_DIR := packages

config SOC_STM32F302CC
    bool
    select SOC_SERIES_STM32F3
    select RT_USING_COMPONENTS_INIT
    select RT_USING_USER_MAIN
    default y

config BOARD_COOLING_CTRL_BOARD
    bool
    prompt "CoolingCtrlBoard V1.0"
    default y

source "$(RTT_DIR)/Kconfig"
osource "$PKGS_DIR/Kconfig"
rsource "../libraries/Kconfig"

if !RT_USING_NANO
rsource "board/Kconfig"
endif
```
